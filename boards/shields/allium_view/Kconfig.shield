## boards/shields/allium_view/Kconfig.shield
```kconfig
# Copyright (c) 2023 The ZMK Contributors
# SPDX-License-Identifier: MIT

config SHIELD_ALLIUM_VIEW
    def_bool $(shields_list_contains,allium_view)
```

## config/west.yml
```yaml
manifest:
  defaults:
    revision: v0.3
  remotes:
    - name: zmkfirmware
      url-base: https://github.com/zmkfirmware
    - name: chazrowe
      url-base: https://github.com/ChazRowe
  projects:
    - name: zmk
      remote: zmkfirmware
      import: app/west.yml
    - name: zmk-persistent-default-layer
      remote: chazrowe
      revision: d2b21e5a03ec31db80a511f068e373e59d13e788
  self:
    path: config
```
